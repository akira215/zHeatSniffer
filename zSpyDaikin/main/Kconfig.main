## zSpyDaikin/main/Kconfig.main
```kconfig
menu "ALDES VMC"

    config VMC_POLLING_MS
        int "Polling delay for VMC in ms"
        range 1000 3600000
        default 2500
        help
            Delay between 2 queries to VMC device

    config VMC_POLLING_GEN_DATA
          int "Polling delay for general VMC data in seconds"
        range 30 3600000
        default 300
        help
            Delay between 2 queries to VMC device for regulation params, filters, season, speed settings

endmenu

menu "Pin layout"
    config PIN_LED
        int "On Board LED GPIO Num"
        range ENV_GPIO_RANGE_MIN ENV_GPIO_OUT_RANGE_MAX
        default 23
        help
            GPIO number for Led that App will use as UI.    
    
    config PIN_BUTTON
        int "On Board Button GPIO Num"
        range ENV_GPIO_RANGE_MIN ENV_GPIO_OUT_RANGE_MAX
        default 9
        help
            GPIO number for the button that App will use as UI.
    
endmenu
```

## zSpyDaikin/sdkconfig.defaults
```kconfig
#
# Partition Table
#
# CONFIG_PARTITION_TABLE_SINGLE_APP is not set
# CONFIG_PARTITION_TABLE_SINGLE_APP_LARGE is not set
# CONFIG_PARTITION_TABLE_TWO_OTA is not set
# CONFIG_PARTITION_TABLE_TWO_OTA_LARGE is not set
CONFIG_PARTITION_TABLE_CUSTOM=y
CONFIG_PARTITION_TABLE_CUSTOM_FILENAME="partitions.csv"
CONFIG_PARTITION_TABLE_FILENAME="partitions.csv"
CONFIG_PARTITION_TABLE_OFFSET=0x8000
CONFIG_PARTITION_TABLE_MD5=y
# end of Partition Table

#
# Project Settings
#
CONFIG_PIN_LED=23
CONFIG_PIN_BUTTON=9


#
# Log Level
#
CONFIG_LOG_DEFAULT_LEVEL_INFO=y
# CONFIG_LOG_DEFAULT_LEVEL=3

# CONFIG_LOG_MAXIMUM_LEVEL_DEBUG is not set
CONFIG_LOG_MAXIMUM_LEVEL_VERBOSE=y
# CONFIG_LOG_MAXIMUM_LEVEL=3



# CONFIG_ESP_CONSOLE_UART_DEFAULT is not set
CONFIG_ESP_CONSOLE_USB_SERIAL_JTAG=y
# CONFIG_ESP_CONSOLE_UART_CUSTOM is not set
# CONFIG_ESP_CONSOLE_NONE is not set
CONFIG_ESP_CONSOLE_SECONDARY_NONE=y
CONFIG_ESP_CONSOLE_USB_SERIAL_JTAG_ENABLED=y
CONFIG_ESP_CONSOLE_UART_NUM=-1
```
